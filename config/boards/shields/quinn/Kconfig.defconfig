## config/west.yml
```yaml
manifest:
  remotes:
    - name: zmkfirmware
      url-base: https://github.com/zmkfirmware
  projects:
    - name: zmk
      remote: zmkfirmware
      revision: main
      import: 
        file: app/west.yml
        name-blocklist:
          - mechwild
  self:
    path: config
```
